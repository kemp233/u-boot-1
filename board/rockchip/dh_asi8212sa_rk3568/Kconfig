## board/rockchip/dh_asi8212sa_rk3568/Kconfig
```kconfig
if TARGET_DH_ASI8212SA

config SYS_BOARD
	default "dh_asi8212sa_rk3568"

config SYS_VENDOR
	default "rockchip"

config SYS_CONFIG_NAME
	default "dh_asi8212sa_rk3568"

endif
```

## board/rockchip/lb2004_rk3566/Kconfig
```kconfig
if TARGET_LB2004_RK3566

config SYS_BOARD
	default "lb2004_rk3566"

config SYS_VENDOR
	default "rockchip"

config SYS_CONFIG_NAME
	default "lb2004_rk3566"

endif
```

## board/rockchip/z96a_rk3568/Kconfig
```kconfig
if TARGET_Z96A_RK3568

config SYS_BOARD
	default "z96a_rk3568"

config SYS_VENDOR
	default "rockchip"

config SYS_CONFIG_NAME
	default "z96a_rk3568"

endif
```
